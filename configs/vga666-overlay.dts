/dts-v1/;
/plugin/;

/{
	compatible = "brcm,bcm2708";

	// There is no VGA driver module, but we need a platform device
	// node (that doesn't already use pinctrl) to hang the pinctrl
	// reference on - leds will do

	fragment@0 {
		target = <&leds>;
		__overlay__ {
			pinctrl-names = "default";
			pinctrl-0 = <&vga666_pins>;
		};
	};

	fragment@1 {
		target = <&gpio>;
		__overlay__ {
			vga666_pins: vga666_pins {
				brcm,pins = <2 3 6 7 8 9>;
				brcm,function = <6>; /* alt2 */
				brcm,pull = <0>; /* no pull */
			};
		};
	};
};
